## west.yml
```
# See the west documentation for more information:
#
# https://developer.nordicsemi.com/nRF_Connect_SDK/doc/latest/zephyr/guides/west/index.html

manifest:
  self:
    path: mbus-app

  # List of git repositories which make up the application
  projects:
    - name: zephyr
      url: https://github.com/zephyrproject-rtos/zephyr
      revision: v3.6.0
      import: true

    - name: mbus
      url: https://github.com/kartben/zephyr-mbus-module
      revision: main
      submodules: true
      path: modules/lib/mbus
```

## prj.conf
```kconfig
#
# System
#
CONFIG_LOG=y
CONFIG_LOG_DEFAULT_LEVEL=3
CONFIG_HWINFO=y
CONFIG_SHELL=y
CONFIG_HEAP_MEM_POOL_SIZE=16385
CONFIG_MAIN_STACK_SIZE=2048
CONFIG_SYSTEM_WORKQUEUE_STACK_SIZE=2048
CONFIG_MINIMAL_LIBC_MALLOC_ARENA_SIZE=32768

#
# POSIX API
#
CONFIG_POSIX_MAX_FDS=4
CONFIG_POSIX_API=y
# CONFIG_POSIX_MQUEUE is not set

#
# Settings subsystem
#
CONFIG_FLASH=y
CONFIG_NVS=y
CONFIG_FLASH_MAP=y
CONFIG_SETTINGS=y
CONFIG_SETTINGS_SHELL=y

#
# M-Bus module's Kconfig depends on SERIAL, UART, and RING_BUFFER
#
CONFIG_MBUS=y
```

## src/main.c
```c
/* M-Bus master module for Zephyr
 *
 * Copyright (C) 2022  Addiva Elektronik AB
 *
 * Author: Joachim Wiberg <joachim.wiberg@addiva.se>
 */
#define MODULE main

#include <zephyr/logging/log.h>

LOG_MODULE_REGISTER(MODULE);

int main(void) { return 0; }
```
